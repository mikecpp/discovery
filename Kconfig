## Kconfig
```kconfig
mainmenu "Discovery Configuration"

menu "Components"

source "components/webserver/Kconfig"
source "components/icmp/Kconfig"

endmenu

menu "Discovery"

config DISCOVERY
    bool
    default y

config DISCOVERY_INTERFACE
    string "Network interface"
    default ""
    help
      Interface whose subnet is scanned. Leave empty to use the interface
      of the default route, or the first interface with an IPv4 address.

config DISCOVERY_THREADS
    int "Scan threads"
    range 1 256
    default 32

config DISCOVERY_MAX_HOSTS
    int "Maximum hosts per scan"
    range 1 65534
    default 4096

config DISCOVERY_WATCH_INTERVAL
    int "Status watch interval (seconds)"
    range 1 3600
    default 5
    help
      How often every known device is pinged again to refresh its status.

config DISCOVERY_RESCAN_INTERVAL
    int "Full rescan interval (seconds)"
    range 5 86400
    default 120
    help
      How often the whole subnet is scanned again to find new devices.

config DISCOVERY_OFFLINE_MISSES
    int "Missed replies before offline"
    range 1 10
    default 2

config DISCOVERY_IDENTIFY
    bool "Identify device type and OS"
    default y
    help
      Guess the device type and operating system from the reply TTL,
      the MAC vendor and a short TCP port probe.

if DISCOVERY_IDENTIFY

config DISCOVERY_PROBE_TIMEOUT_MS
    int "TCP probe timeout (milliseconds)"
    range 50 10000
    default 500

config DISCOVERY_RESOLVE_NAMES
    bool "Resolve host names with reverse DNS"
    default y

endif

endmenu
```

## components/icmp/Kconfig
```kconfig
menuconfig COMPONENT_ICMP
    bool "ICMP"
    default y
    help
      ICMP echo (ping) client used to detect whether a device answers.

if COMPONENT_ICMP

config ICMP_TIMEOUT_MS
    int "Reply timeout (milliseconds)"
    range 10 60000
    default 1000

config ICMP_DATA_SIZE
    int "Echo payload size (bytes)"
    range 0 1400
    default 56

config ICMP_EXTERNAL_FALLBACK
    bool "Fall back to the system ping command"
    default y
    help
      When neither an ICMP datagram socket nor a raw socket can be
      opened (no CAP_NET_RAW and ping_group_range disabled), run the
      system ping command instead.

config ICMP_EXTERNAL_COMMAND
    string "System ping command"
    default "/usr/bin/ping"
    depends on ICMP_EXTERNAL_FALLBACK

endif
```

## components/webserver/Kconfig
```kconfig
menuconfig COMPONENT_WEBSERVER
    bool "Web server"
    default y
    help
      HTTP server that serves the embedded Vue 3 frontend and the JSON API.

if COMPONENT_WEBSERVER

config WEBSERVER_ADDRESS
    string "Bind address"
    default "0.0.0.0"

config WEBSERVER_PORT
    int "Port"
    range 1 65535
    default 8080

config WEBSERVER_TITLE
    string "Page title"
    default "Device Discovery"

config WEBSERVER_OPEN_BROWSER
    bool "Open web browser on start"
    default y
    help
      Open the page in the default browser once the server is listening.
      Uses explorer.exe on WSL and xdg-open on Linux.

endif
```

## defconfig
```kconfig
#
# Components
#
CONFIG_COMPONENT_WEBSERVER=y
CONFIG_WEBSERVER_ADDRESS="0.0.0.0"
CONFIG_WEBSERVER_PORT=8080
CONFIG_WEBSERVER_TITLE="Device Discovery"
CONFIG_WEBSERVER_OPEN_BROWSER=y
CONFIG_COMPONENT_ICMP=y
CONFIG_ICMP_TIMEOUT_MS=1000
CONFIG_ICMP_DATA_SIZE=56
CONFIG_ICMP_EXTERNAL_FALLBACK=y
CONFIG_ICMP_EXTERNAL_COMMAND="/usr/bin/ping"
# end of Components

#
# Discovery
#
CONFIG_DISCOVERY=y
CONFIG_DISCOVERY_INTERFACE=""
CONFIG_DISCOVERY_THREADS=32
CONFIG_DISCOVERY_MAX_HOSTS=4096
CONFIG_DISCOVERY_WATCH_INTERVAL=5
CONFIG_DISCOVERY_RESCAN_INTERVAL=120
CONFIG_DISCOVERY_OFFLINE_MISSES=2
CONFIG_DISCOVERY_IDENTIFY=y
CONFIG_DISCOVERY_PROBE_TIMEOUT_MS=500
CONFIG_DISCOVERY_RESOLVE_NAMES=y
# end of Discovery
```
